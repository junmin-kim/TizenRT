## apps/examples/calculator_client/Kconfig
```kconfig
#
# For a description of the syntax of this configuration file,
# see kconfig-language at https://www.kernel.org/doc/Documentation/kbuild/kconfig-language.txt
#

config EXAMPLES_CALCULATOR_CLIENT
	bool "Calculator client example"
	default n
	---help---
		Enable the Calculator client example

config USER_ENTRYPOINT
	string
	default "calculator_client_main" if ENTRY_CALCULATOR_CLIENT
```

## apps/examples/calculator_server/Kconfig
```kconfig
#
# For a description of the syntax of this configuration file,
# see kconfig-language at https://www.kernel.org/doc/Documentation/kbuild/kconfig-language.txt
#

config EXAMPLES_CALCULATOR_SERVER
	bool "Calculator server example"
	default n
	---help---
		Enable the Calculator server example

config USER_ENTRYPOINT
	string
	default "calculator_server_main" if ENTRY_CALCULATOR_SERVER
```

## apps/examples/helloxx_client/Kconfig
```kconfig
#
# For a description of the syntax of this configuration file,
# see kconfig-language at https://www.kernel.org/doc/Documentation/kbuild/kconfig-language.txt
#

config EXAMPLES_HELLOXX_CLIENT
	bool "\"Hello, World!\" C++ client example"
	default n
	---help---
		Enable the \"Hello, World!\" C++ client example

config USER_ENTRYPOINT
	string
	default "helloxx_client_main" if ENTRY_HELLOXX_CLIENT
```

## apps/examples/helloxx_server/Kconfig
```kconfig
#
# For a description of the syntax of this configuration file,
# see kconfig-language at https://www.kernel.org/doc/Documentation/kbuild/kconfig-language.txt
#

config EXAMPLES_HELLOXX_SERVER
	bool "\"Hello, World!\" C++ server example"
	default n
	---help---
		Enable the \"Hello, World!\" C++ server example

config USER_ENTRYPOINT
	string
	default "helloxx_server_main" if ENTRY_HELLOXX_SERVER
```
